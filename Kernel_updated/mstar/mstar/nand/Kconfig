## Kernel_updated/mstar/mstar/nand/Kconfig
```kconfig
config MSTAR_NAND
  select MTD
  select MTD_CHAR
  select MTD_BLKDEVS
  select NFTL
  select NFTL_RW
  select MTD_OOPS

  select MTD_COMPLEX_MAPPINGS
  select MTD_BLOCK2MTD
  select MTD_NAND_MUSEUM_IDS
  select MTD_NAND_PLATFORM
  select MTD_CMDLINE_PARTS
  select MTD_UBI
  #select MTD_UBI_WL_THRESHOLD
  #select MTD_UBI_BEB_RESERVE
  select SCSI_LOWLEVEL
  select AUTOFS_FS

  #select FAT_FS
  #select MSDOS_FS
  #select VFAT_FS
  #select FAT_DEFAULT_CODEPAGE
  #select FAT_DEFAULT_IOCHARSET

  select MTD_DEBUG
  #select MTD_DEBUG_VERBOSE
  select MTD_CONCAT
  select MTD_PARTITIONS
  select MTD_NAND
  #select JFFS2_FS
  #select JFFS2_FS_DEBUG
  #select JFFS2_FS_WRITEBUFFER
  tristate "NAND"
  default n

help
Enable compilation option for hy27us MTD driver

    
config MSTAR_NAND_IP
	string
	default "titania" if MSTAR_TITANIA
	default "titania2" if MSTAR_TITANIA2
	default "titania3" if (MSTAR_TITANIA3||MSTAR_TITANIA10)
	default "euclid" if MSTAR_EUCLID
	default "fcie3"
```

## Kernel_updated/mstar/mstar/onenand/Kconfig
```kconfig
config MSTAR_ONENAND

#  select MTD
#  select MTD_CHAR
#  select MTD_BLKDEVS
#  select NFTL
#  select NFTL_RW
#  select MTD_OOPS
#
#  select MTD_COMPLEX_MAPPINGS
#  select MTD_BLOCK2MTD
#  select MTD_NAND_MUSEUM_IDS
#  select MTD_NAND_PLATFORM
#  select MTD_CMDLINE_PARTS
#  select MTD_UBI
#  #select MTD_UBI_WL_THRESHOLD
#  #select MTD_UBI_BEB_RESERVE
#  select SCSI_LOWLEVEL
#  select AUTOFS_FS
#
#  select FAT_FS
#  select MSDOS_FS
#  select VFAT_FS
#  #select FAT_DEFAULT_CODEPAGE
#  #select FAT_DEFAULT_IOCHARSET
#
#  select MTD_DEBUG
#  #select MTD_DEBUG_VERBOSE
#  select MTD_CONCAT
#  select MTD_PARTITIONS
#  select MTD_NAND
#  select JFFS2_FS
#  #select JFFS2_FS_DEBUG
#  select JFFS2_FS_WRITEBUFFER

tristate "ONENAND"
default n

help
    MStar ONENAND driver function

config MSTAR_ONENAND_IP
	string
	default "titania2" if MSTAR_TITANIA2
	default "titania3" if (MSTAR_TITANIA3||MSTAR_TITANIA10)
	default "fcie4" if (MSTAR_TITANIA8 || MSTAR_TITANIA9 || MSTAR_TITANIA12 || MSTAR_TITANIA13)
	default "error"
```

## Kernel_updated/mstar/mstar/ramdisk/Kconfig
```kconfig
config MSTAR_RAMDISK

tristate "RAMDISK"
 
help
    MStar ramdisk driver function
    
```

## Kernel_updated/mstar/mstar/rfid/Kconfig
```kconfig
config MSTAR_RFID

tristate "RFID"

help
    MStar RFID driver function for MSR chips.
    Support device: MSR3201
         
    It is hard coded to use PWM3 and GPIO88/ET_CRS D10 during
    system setup. It only run one time when the system is setup.
    Read the unique ID and save it in a static matrix,
    wait nad passing the ID to user program.
    It is very sensitive to timing sequence

    * CAUTION * only for babao BD-556A-T2, Say NO for other cases.
```

## Kernel_updated/mstar/mstar/sc/Kconfig
```kconfig
config MSTAR_SC
tristate "Smart card"
default n
help
    enable MStar smart card driver.
```

## Kernel_updated/mstar/mstar/sdmmc/Kconfig
```kconfig
config MSTAR_SDMMC
	bool "Mstar SD/MMC Card Interface Support"
	depends on MMC
	default n
	---help---
        Enable SD/MMC Driver Support for MStar Product

config MSTAR_SDMMC_TCARD
	bool "Mstar SD/MMC T-Flash Card Using"
	depends on MSTAR_SDMMC
	default n
  ---help---
        For T-Flash Socket, We don't use WP Pin

config MSTAR_SDMMC_REVWP
	bool "Mstar SD/MMC Reverse WP Pin"
	depends on !MSTAR_SDMMC_TCARD && MSTAR_SDMMC
	default n
  ---help---
        For SD Socket Type, Revert the WP pin Value for Write Protection

config MSTAR_SDMMC_DUALCARDS
	bool "Mstar SD/MMC Dual Cards Support"
	depends on MSTAR_SDMMC
	default n
  ---help---
        Enable Dual SD/MMC Card Interface

config MSTAR_SDMMC1_MAXCLK
    int "Mstar SD/MMC1 Maximum Clock"
    depends on MSTAR_SDMMC
    default 32000000
    range 300000 36000000
    ---help---
      The maximun Clock of SDMMC1

config MSTAR_SDMMC1_MAXDLVL
    int "Mstar SD/MMC1 Maximum DownLevel"
    depends on MSTAR_SDMMC
    default 0
    range 0 5
    ---help---
      The maximun Clock Downgrade Level of SDMMC1

config MSTAR_SDMMC1_PORT1
	bool "Mstar SD/MMC select slot1 to port1"
	depends on MSTAR_SDMMC && MSTAR_AMBER3
	default n
	---help---
        For SD, select sd card slot1 to port1
  
config MSTAR_SDMMC1_PORT2
	bool "Mstar SD/MMC select slot1 to port2"
	depends on MSTAR_SDMMC && MSTAR_AMBER3
	default n
	---help---
        For SD, select sd card slot1 to port2        

config MSTAR_SDMMC1_HOTP
	bool "Mstar SD/MMC1 Hotplug Support"
	depends on MSTAR_SDMMC
	default n
  ---help---
        For SD1, Whether we need to run hotplug funciton (HW consideration)                
        
config MSTAR_SDMMC_GPIO_CDZ
	bool "Mstar SD/MMC CDZ pin use GPIO"
	depends on MSTAR_SDMMC1_HOTP && MSTAR_AMBER3
	default n
	---help---
        Use other GPIO pin for card detect function

config MSTAR_SDMMC_GPIO_PM10
	bool "Mstar SD/MMC CDZ pin use GPIO PM10"
	depends on MSTAR_SDMMC_GPIO_CDZ && MSTAR_AMBER3
	default n
	---help---
        Use other GPIO PM10 pin for card detect function
        
config MSTAR_SDMMC_GPIO_PM16
	bool "Mstar SD/MMC CDZ pin use GPIO PM16"
	depends on MSTAR_SDMMC_GPIO_CDZ && MSTAR_AMBER3
	default n
	---help---
        Use other GPIO PM16 pin for card detect function
        
config MSTAR_SDMMC1_GPIO_PM10
	bool "Mstar SD/MMC1 CDZ pin use GPIO PM10"
	depends on MSTAR_SDMMC1_HOTP 
	default n
	---help---
        Use other GPIO PM10 pin for card detect function            
        
config MSTAR_SDMMC1_GPIO_PM16
	bool "Mstar SD/MMC1 CDZ pin use GPIO PM16"
	depends on MSTAR_SDMMC1_HOTP 
	default n
	---help---
        Use other GPIO PM16 pin for card detect function
        
config MSTAR_SDMMC1_GPIO_PADSPI2DI
	bool "Mstar SD/MMC1 CDZ pin use PADSPI2DI"
	depends on MSTAR_SDMMC1_HOTP 
	default n
	---help---
        Use other PADSPI2DI pin for sd1 card detect function               

config MSTAR_SDMMC1_PASSLVL
    int "Mstar SD/MMC1 Pass Level"
    depends on MSTAR_SDMMC
    default 0
    range 0 5
    ---help---
      The maximun Clock Pass Level of SDMMC1

        
config MSTAR_SDMMC1_FAKECDZ
	bool "Mstar SD/MMC1 Fake CDZ"
	depends on !MSTAR_SDMMC1_HOTP && MSTAR_SDMMC
	default n
  ---help---
        For SD1, Whether we need to assume card detection always true (HW consideration)        
        

config MSTAR_SDMMC2_MAXCLK
    int "Mstar SD/MMC2 Maximum Clock"
    depends on MSTAR_SDMMC_DUALCARDS
    default 32000000
    range 300000 50000000
    ---help---
      The maximun Clock of SDMMC2

config MSTAR_SDMMC2_MAXDLVL
    int "Mstar SD/MMC2 Maximum DownLevel"
    depends on MSTAR_SDMMC_DUALCARDS
    default 0
    range 0 5
    ---help---
      The maximun Clock Downgrade Level of SDMMC2
      
config MSTAR_SDMMC2_PASSLVL
    int "Mstar SD/MMC2 Pass Level"
    depends on MSTAR_SDMMC_DUALCARDS
    default 0
    range 0 5
    ---help---
      The maximun Clock Pass Level of SDMMC2
      
config MSTAR_SDMMC2_HOTP
	bool "Mstar SD/MMC2 Hotplug Support"
	depends on MSTAR_SDMMC_DUALCARDS && MSTAR_SDMMC
	default n
  ---help---
        For SD2, Whether we need to run hotplug funciton (HW consideration)

config MSTAR_SDMMC2_GPIO_PM10
	bool "Mstar SD/MMC2 CDZ pin use GPIO PM10"
	depends on MSTAR_SDMMC2_HOTP 
	default n
	---help---
        Use other GPIO PM10 pin for card detect function
        
config MSTAR_SDMMC2_GPIO_PM16
	bool "Mstar SD/MMC2 CDZ pin use GPIO PM16"
	depends on MSTAR_SDMMC2_HOTP 
	default n
	---help---
        Use other GPIO PM16 pin for card detect function       
        
config MSTAR_SDMMC2_GPIO_PADSPI2DI
	bool "Mstar SD/MMC2 CDZ pin use PADSPI2DI"
	depends on MSTAR_SDMMC2_HOTP 
	default n
	---help---
        Use other PADSPI2DI pin for sd2 card detect function

config MSTAR_SDMMC2_FAKECDZ
	bool "Mstar SD/MMC2 Fake CDZ"
	depends on !MSTAR_SDMMC2_HOTP && MSTAR_SDMMC && MSTAR_SDMMC_DUALCARDS
	default n
  ---help---
        For SD2, Whether we need to assume card detection always true (HW consideration)
        
```

## Kernel_updated/mstar/mstar/semutex/Kconfig
```kconfig
config MSTAR_SEMUTEX

tristate "SEMUTEX"
 
help
    MStar SEMUTEX driver function
default y    
    
```

## Kernel_updated/mstar/mstar/shire/Kconfig
```kconfig
if MSTAR_URANUS4

config MSTAR_SHIRE
       bool "Shire"
       default n

       help
           MStar Shire driver function

endif
```

## Kernel_updated/mstar/mstar/software_ir/Kconfig
```kconfig
config MSTAR_SOFTWARE_IR

tristate "Software IrDA"

help
    MStar SoftwareIrDA driver function
```

## Kernel_updated/mstar/mstar/swreg/Kconfig
```kconfig
config MSTAR_SWREG

tristate "SWREG"

help
    MStar SW special register driver function
```

## Kernel_updated/mstar/mstar/trustzone/Kconfig
```kconfig
#menu: create a menu for the following "config"
#menconfig: create a config a "that" menu

menuconfig TZ_SUPPORT
	tristate "Trustzone support"

if TZ_SUPPORT

config TZ_WORLD_TALK_SUPPORT
	tristate "TZ support"
	help
	  test

config WORLD_TALK_SUPPORT2
	bool "TZ support2"
	help
	  test2

endif
```

## Kernel_updated/mstar/mstar/vid_pre_alloc_mem/Kconfig
```kconfig
config MSTAR_VPOOL

tristate "VPOOL"
 
help
    MStar VPOOL driver function
    
```

## Kernel_updated/kernel/arch/arm/Kconfig.codedump
```kconfig
menu "Kernel Code Dump Tool"

config BINFMT_ELF_COMP
	bool "Kernel support for compressed ELF binaries(Ultimate Coredump)"
	default y

config SEPARATE_PRINTK_FROM_USER
    bool "It separate messages(printf, printk) between user and kernel."
    default y

config SHOW_FAULT_TRACE_INFO
    bool "Show trace info on user page fault"
    default y
    help
      Shows trace information when "Segmentation fault" or "Bus error" occurs.
      Prints registers, call stack, maps, user stack, etc.
	  
config SHOW_PC_LR_INFO
    bool "Show address range including PC, LR"
    default y
	
config DUMP_USE_REGSET
    bool "Show address range including PC, LR"
    default y

endmenu
```

## Kernel_updated/mstar/arm-boards/edison/Kconfig
```kconfig
menu "MStar MSB25xx PCB Diversity"

choice
        prompt "Board selection"
        default  MS2510DVBT43

config G35
        bool "G35"

config G35MP
        bool "G35MP"

config MS2510ATSC43
        bool "MS2510ATSC43"

config MS2510DVBT43
        bool "MS2510DVBT43"

config MS2516QC7A
        bool "MS2516QC7A"

config MS2516SZ7A
        bool "MS2516SZ7A"

config MS2517QC7D
        bool "MS2517QC7D"

config MSB2510_35
        bool "MSB2510_35"

endchoice
endmenu
```

## Kernel_updated/mstar/mips-boards/titania2/project/Kconfig
```kconfig
#===================================================
#  Board Selection
#===================================================
choice
	prompt "MStar DTV Board Config"
	default MSTAR_TITANIA_BD_CUSXXX

config MSTAR_TITANIA_BD_CUSXXX
	bool BD_CUSXXX

#config MSTAR_TITANIA_BD_CUSXXX                              <- // MODME, >> add new board here <<
#	bool BD_CUSXXX                                          <- // MODME, >> add new board here <<

endchoice



#===================================================
#  MMAP Selection
#===================================================
choice
	prompt "MStar DTV Memory Map Config"
	default MSTAR_TITANIA_MMAP_128MB_128MB_FOR_CUSXXX

config MSTAR_TITANIA_MMAP_128MB_128MB_FOR_CUSXXX
	bool "MMAP 128MB+128MB for CUSXXX"

#config MSTAR_TITANIA_MMAP_XXX_FOR_CUSXXX                    <- // MODME, >> add new mmap here <<
#	bool "MMAP XXX for CUSXXX"                              <- // MODME, >> add new mmap here <<

endchoice
```

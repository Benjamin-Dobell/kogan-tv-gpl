## Kernel_updated/mstar/mstar/alsa_audio_driver/Kconfig
```kconfig
# drivers/MStar/alsa_audio_driver/Kconfig

menuconfig MSTAR_ALSA_AUDIO_DRIVER
	tristate "ALSA Audio Driver"
	default n
	depends on SND
	help
		MStar ALSA Audio Driver.

		Note!
		Before enable "MStar ASLA Audio Driver",
		be remembered to enable "Linux ALSA Kernel Module" first,
		and enable the required modules then.

		[Device Driver]->[Sound card support]->[Advanced Linux Sound Architecture]->...

if MSTAR_ALSA_AUDIO_DRIVER

source "drivers/mstar/alsa_audio_driver/drv/Kconfig"

source "drivers/mstar/alsa_audio_driver/hal/Kconfig"

endif #MSTAR_ALSA_AUDIO_DRIVER
```

## Kernel_updated/mstar/mstar/alsa_audio_driver/drv/Kconfig
```kconfig
config MSTAR_ALSA_AUDIO_DRIVER_DRV
	tristate "ALSA Audio Driver - DRV Layer"
	default m
	depends on MSTAR_ALSA_AUDIO_DRIVER
	help
		MStar ALSA Audio Driver - DRV Layer.
```

## Kernel_updated/mstar/mstar/alsa_audio_driver/hal/Kconfig
```kconfig
config MSTAR_ALSA_AUDIO_DRIVER_HAL
	tristate "ALSA Audio Driver - HAL Layer"
	default m
	depends on MSTAR_ALSA_AUDIO_DRIVER_DRV
	help
		MStar ALSA Audio Driver - HAL Layer.
```

## Kernel_updated/mstar/mstar/emac/Kconfig
```kconfig
config MSTAR_EMAC
select NET
select NET_ETHERNET
select MII
select PACKET
select USE_POLICY_FWD
select INET
select NETDEVICES

tristate "EMAC"
default y

---help---
Enable compilation option for driver EMAC

if MSTAR_EMAC
config EMAC_SUPPLY_RNG
bool "Supply to random number generator device"
default n
help
    Supply to random number generator device

config ETHERNET_ALBANY
bool "Supply to internel PHY"
default n
help
    Supply to internel PHY

config MSTAR_HW_TX_CHECKSUM
bool "Supply to hardware TX checksum"
default n
help
    Supply to hardware TX checksum
endif
```

## Kernel_updated/mstar/mstar/flash/Kconfig
```kconfig
config MSTAR_SPI_FLASH

  select MTD
  select MTD_CHAR
  select MTD_BLKDEVS
  select NFTL
  select NFTL_RW
  select MTD_OOPS
  
  select MTD_COMPLEX_MAPPINGS
  select MTD_BLOCK2MTD
  select MTD_CMDLINE_PARTS
  select SCSI_LOWLEVEL
  select AUTOFS_FS
  
  select FAT_FS
  select MSDOS_FS
  select VFAT_FS
  
  select MTD_DEBUG
  #select MTD_DEBUG_VERBOSE
  select MTD_CONCAT
  select MTD_PARTITIONS
  #select MTD_NAND
  #select JFFS2_FS
  #select JFFS2_FS_DEBUG
  #select JFFS2_FS_WRITEBUFFER

tristate "SPI Flash"
default n

---help---
Enable compilation option for driver SPI Flash.
	
```

## Kernel_updated/mstar/mstar/fusion/Kconfig
```kconfig
config MSTAR_FUSION
	tristate "Fusion"
	---help---
	  Fusion is the IPC API used by DirectFB and FusionSound.
```

## Kernel_updated/mstar/mstar/fusion_8_7/Kconfig
```kconfig
config MSTAR_FUSION_8_7
	tristate "Fusion(For DirectFB1.6.2 Only!)"
	---help---
	  Fusion is the IPC API used by DirectFB and FusionSound.
```

## Kernel_updated/mstar/mstar/gflip/Kconfig
```kconfig
config MSTAR_GFLIP
tristate "GFLIP"
help
    enable MStar GFLIP driver.

if MSTAR_GFLIP

if MSTAR_TITANIA3
if MSTAR_GPIO
config MSATR_3D_LR_REPORT
  bool "Support 3D LR Report"
  default n
  help
    Support 3D LR report
endif
endif


config MSATR_VE_CAPTURE_SUPPORT
  bool "Support VE Capture Function"
  default y if (MSTAR_TITANIA12 || MSTAR_JANUS2 || MSTAR_AMBER5)
  default y
  help
    If Support VE Capture feature

config MSATR_NEW_FLIP_FUNCTION_ENABLE
  bool "Enable the new flip function(to replace the old one)"
  default y
  help
    If use the new function, it will make sure the flip is done in hardware vsync peroid

endif
```

## Kernel_updated/mstar/mstar/gmac/Kconfig
```kconfig
config MSTAR_GMAC
select NET
select NET_ETHERNET
select MII
select PACKET
select USE_POLICY_FWD
select INET
select NETDEVICES

tristate "GMAC"
default n

---help---
Enable compilation option for driver GMAC

if MSTAR_GMAC
config GMAC_SUPPLY_RNG
bool "Supply to random number generator device"
default n
help
    Supply to random number generator device

config GMAC_ETHERNET_ALBANY
bool "Supply to internel PHY"
default n
help
    Supply to internel PHY

config MSTAR_GMAC_HW_TX_CHECKSUM
bool "Supply to hardware TX checksum"
default n
help
    Supply to hardware TX checksum
endif
```

## Kernel_updated/mstar/mstar/mpool/Kconfig
```kconfig
config MSTAR_MPOOL

tristate "MPOOL"
 
help
    MStar MPOOL driver function
    
```

## Kernel_updated/mstar/mstar/msgio/Kconfig
```kconfig
config MSTAR_MSGIO

tristate "MSGIO - serial message logging to userspace"

help
    deliver all serial message into one centric userspeace node.
```

## Kernel_updated/mstar/mstar/msglog/Kconfig
```kconfig
config MSTAR_MSGLOG

tristate "MSGLOG - serial message logging system"

help
    Saving all serial message into the log file.

if 0

config MSTAR_MSGLOG_EMERGENCY_LOG
  bool "MSGLOG - Emergency Log"
  default n
  help
    Save emergency serial message into flash.

endif
```

## Kernel_updated/mstar/mstar/mstar_fb/Kconfig
```kconfig
config MSTAR_FB

tristate "FB"
	default n
	help
		Enable compilation option for driver FB
```

## Kernel_updated/mstar/mstar/msystem/Kconfig
```kconfig
config MSTAR_MSYSTEM

tristate "MSYSTEM"
 
help
    MStar all in one system driver function
```
